## dts/bindings/rfid/st,cr95hf-spi.yaml
```yaml
# Copyright 2025,2026 Conny Marco Menebröcker
# SPDX-License-Identifier: Apache-2.0
description: ST CR95HF RFID driver

compatible: "st,cr95hf"

include: spi-device.yaml

properties:
  irq-in-gpios:
    type: phandle-array
    required: true

  irq-out-gpios:
    type: phandle-array
```

## soc/st/stm32/stm32l1x/Kconfig.defconfig.stm32l100xb
```kconfig
# STMicroelectronics STM32L100XB MCU

# Copyright (c) 2025,2026 Conny Marco Menebröcker
# SPDX-License-Identifier: Apache-2.0

if SOC_STM32L100XB

config NUM_IRQS
	default 46

endif # SOC_STM32L100XB
```
